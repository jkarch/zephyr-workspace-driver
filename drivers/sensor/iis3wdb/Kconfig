## drivers/sensor/iis3wdb/Kconfig
```kconfig
# Copyright (c) 2021 Nordic Semiconductor ASA
# SPDX-License-Identifier: Apache-2.0

config IIS3WDB
	bool "IIS3WDB Vibration Sensor"
	default y
	depends on DT_HAS_ST_IIS3WDB_ENABLED
	select SPI
	help
	  Enable IIS3WDB Vibration Sensor
```

## dts/bindings/sensor/st,iis3wdb.yaml
```yaml
# Copyright (c) 2021 Nordic Semiconductor ASA
# SPDX-License-Identifier: Apache-2.0

description: |
  An example sensor that reads the GPIO level defined in input-gpios. The
  purpose of this sensor is to demonstrate how to create out-of-tree drivers.

  Example definition in devicetree:

    vibe0 {
        compatible = "st,iis3wdb";
        //fill in
    };

compatible: "st,iis3wdb"

include: spi-device.yaml
on-bus: spi
```
